## connectivity/wlan/core/gen4-mt79xx/configs/MT7961/dualcard_dev/defconfig
```kconfig
ifeq ($(CONFIG_MTK_COMBO_WIFI_HIF), pcie)
CONFIG_SUPPORT_MULTI_CARD=y
else ifeq ($(CONFIG_MTK_COMBO_WIFI_HIF), usb)
CONFIG_SUPPORT_MULTI_CARD=y
else
CONFIG_SUPPORT_MULTI_CARD=n
endif
```

## connectivity/wlan/core/gen4m/configs/MT6639/ce/defconfig
```kconfig
CONFIG_SUPPORT_WIFI_DL_BT_PATCH=y
CONFIG_MTK_MDDP_SUPPORT=
CONFIG_MTK_WIFI_WFDMA_BK_RS=n
```

## connectivity/wlan/core/gen4m/configs/MT6639/defconfig
```kconfig
CONFIG_MTK_WIFI_11AX_SUPPORT=y
CONFIG_MTK_WIFI_11BE_SUPPORT=y
CONFIG_MTK_WIFI_11BE_MLO_SUPPORT=y
CONFIG_MTK_WIFI_APS_SUPPORT=y
CONFIG_MTK_WIFI_CONNAC3X=y
CONFIG_NUM_OF_WFDMA_RX_RING=2
CONFIG_NUM_OF_WFDMA_TX_RING=0
CONFIG_MTK_WIFI_UNIFIED_COMMND_SUPPORT=y
CONFIG_MTK_WIFI_TWT_SUPPORT=y
CONFIG_MTK_WIFI_TWT_STA_DIRECT_TEARDOWN=y
CONFIG_MTK_WIFI_TWT_SMART_STA=n
CONFIG_MTK_WIFI_TWT_HOTSPOT_SUPPORT=n
CONFIG_MTK_WIFI_TWT_HOTSPOT_AC_SUPPORT=n
CONFIG_MTK_WIFI_BTWT_SUPPORT=y
CONFIG_MTK_WIFI_11BE_ML_TWT_SUPPORT=y
CONFIG_MLD_LINK_MAX=2
CONFIG_DBDC_MODE=1
CONFIG_MTK_WIFI_6G_SUPPORT=y
CONFIG_SUPPORT_FORCE_ALTX=y
CONFIG_SUPPORT_BW320=y
CONFIG_SUPPORT_TX_DATA_DELAY=y
```

## connectivity/wlan/core/gen4m/configs/MT6639/mobile/defconfig
```kconfig
CONFIG_MTK_WIFI_PMIC_QUERY=y
CONFIG_SUPPORT_TX_HIF_CREDIT_FEATURE=y
CONFIG_MTK_WIFI_SUPPORT_UDS_FWDL=y
CONFIG_TX_HIF_PORT_QUEUE_SUPPORT=y
CONFIG_SUPPORT_PRE_ON_PHY_ACTION=y
CONFIG_MTK_WIFI_WFD_SCC_BALANCE=y
CONFIG_CONTROL_ASPM_BY_FW=y
CONFIG_SUPPORT_PCIE_ASPM=y
CONFIG_WIFI_DRIVER_OWN_DELAY_SUPPORT=y
CONFIG_RX_ZERO_COPY=y
CONFIG_SUPPORT_THERMAL_QUERY=y
CONFIG_SUPPORT_BTM_OFFLOAD=y
CONFIG_SUPPORT_WIFI_DL_BT_PATCH=n
CONFIG_DEVICE_SUSPEND_BY_MOBILE=y
CONFIG_SUPPORT_SINGLE_FW_BINARY=y
CONFIG_TX_WORK_SUPPORT=y
CONFIG_RX_WORK_SUPPORT=y
CONFIG_SUPPORT_TX_FREE_MSDU_WORK=y
```

## connectivity/wlan/core/gen4m/configs/MT6653/defconfig
```kconfig
CONFIG_MTK_WIFI_11AX_SUPPORT=y
CONFIG_MTK_WIFI_11BE_SUPPORT=y
CONFIG_MTK_WIFI_11BE_MLO_SUPPORT=y
CONFIG_MTK_WIFI_11BE_ML_RECONFIG=y
CONFIG_MTK_WIFI_11BE_EPCS=y
CONFIG_MTK_WIFI_11BE_T2LM=y
CONFIG_MTK_WIFI_APS_SUPPORT=y
CONFIG_MTK_WIFI_CONNAC3X=y
CONFIG_NUM_OF_WFDMA_RX_RING=4
CONFIG_NUM_OF_WFDMA_TX_RING=0
CONFIG_MTK_WIFI_UNIFIED_COMMND_SUPPORT=y
CONFIG_MTK_WIFI_TWT_SUPPORT=y
CONFIG_MTK_WIFI_TWT_STA_DIRECT_TEARDOWN=y
CONFIG_MTK_WIFI_TWT_SMART_STA=n
CONFIG_MTK_WIFI_TWT_HOTSPOT_SUPPORT=n
CONFIG_MTK_WIFI_TWT_HOTSPOT_AC_SUPPORT=n
CONFIG_MTK_WIFI_BTWT_SUPPORT=y
CONFIG_MTK_WIFI_11BE_ML_TWT_SUPPORT=y
CONFIG_MLD_LINK_MAX=2
CONFIG_DBDC_MODE=1
CONFIG_MTK_WIFI_6G_SUPPORT=y
CONFIG_SUPPORT_FORCE_ALTX=y
CONFIG_SUPPORT_TX_DATA_DELAY=y
CONFIG_SUPPORT_BW320=y
CONFIG_FILS_SK_OFFLOAD_SUPPORT=y
CONFIG_MTK_WIFI_TRX_DIRECT=y
CONFIG_NOT_CLR_FREE_MSDU_IN_DEACTIVE_NETWORK=y
CONFIG_MTK_WIFI_WFDMA_BK_RS=y
CONFIG_MTK_WIFI_WFDMA_WB=y
CONFIG_MTK_WIFI_CONNAC3X_DS_VER=3600
CONFIG_SUPPORT_WIFI_WFDMA_TX_RING_BK_RS=y
CONFIG_MTK_WIFI_SUPPORT_DSP_FWDL=y
CONFIG_SUPPORT_TESTMODE_FWDL=y
CONFIG_ADJUST_NETIF_TH_BY_BAND=y
CONFIG_SUPPORT_TPUT_FACTOR=y
CONFIG_SUPPORT_CONTROL_PORT_OVER_NL80211=y
CONFIG_SUPPORT_BMC_DISABLE_RETRY_RTS=y
```

## connectivity/wlan/core/gen4m/configs/MT6653/mobile/defconfig
```kconfig
CONFIG_MTK_WIFI_PMIC_QUERY=y
CONFIG_SUPPORT_TX_HIF_CREDIT_FEATURE=y
CONFIG_MTK_WIFI_SUPPORT_SW_SYNC_BY_EMI=y
CONFIG_MTK_WIFI_SUPPORT_UDS_FWDL=y
CONFIG_TX_HIF_PORT_QUEUE_SUPPORT=y
CONFIG_CONTROL_ASPM_BY_FW=y
CONFIG_SUPPORT_PCIE_ASPM=y
CONFIG_SUPPORT_PCIE_PLAT_INT_FLOW=y
CONFIG_WIFI_DRIVER_OWN_DELAY_SUPPORT=y
CONFIG_RX_ZERO_COPY=y
CONFIG_SUPPORT_THERMAL_QUERY=y
CONFIG_SUPPORT_BTM_OFFLOAD=y
CONFIG_SUPPORT_WIFI_DL_BT_PATCH=n
CONFIG_DEVICE_SUSPEND_BY_MOBILE=y
CONFIG_SUPPORT_SINGLE_FW_BINARY=y
CONFIG_SUPPORT_PRE_ON_PHY_ACTION=y
CONFIG_DYNAMIC_DMASHDL_MAX_QUOTA=y
CONFIG_SUPPORT_PWR_LMT_EMI=y
CONFIG_SUPPORT_COEX_DOWNGRADE_BW=n
CONFIG_BCN_PROT=y
CONFIG_MTK_WIFI_XONVRAM_SUPPORT=y
CONFIG_SW_BIP_GMAC=n
CONFIG_MTK_WIFI_SUPPORT_CCM=y
CONFIG_SUPPORT_APGO_CROSS_BAND_CSA=y
CONFIG_MTK_WIFI_SUPPORT_PLCAL=y
CONFIG_REKEY_OFFLOAD=n
CONFIG_MTK_WIFI_SUPPORT_STA_DFS_CHANNEL=y
CONFIG_ABSENCE_TIMEOUT_DETECTION=y
```

## connectivity/wlan/core/gen4m/configs/MT6655/defconfig
```kconfig
CONFIG_MTK_CONNSYS_DEDICATED_LOG_PATH := n
CONFIG_MTK_WIFI_11AX_SUPPORT=y
CONFIG_MTK_WIFI_11BE_SUPPORT=y
CONFIG_MTK_WIFI_11BE_MLO_SUPPORT=y
CONFIG_MTK_WIFI_CONNAC3X=y
CONFIG_NUM_OF_WFDMA_RX_RING=4
CONFIG_NUM_OF_WFDMA_TX_RING=0
CONFIG_MTK_WIFI_UNIFIED_COMMND_SUPPORT=y
CONFIG_MTK_WIFI_TWT_SUPPORT=y
CONFIG_MTK_WIFI_TWT_STA_DIRECT_TEARDOWN=y
CONFIG_MTK_WIFI_TWT_SMART_STA=n
CONFIG_MTK_WIFI_TWT_HOTSPOT_SUPPORT=n
CONFIG_MTK_WIFI_TWT_HOTSPOT_AC_SUPPORT=n
CONFIG_MTK_WIFI_BTWT_SUPPORT=y
CONFIG_MTK_WIFI_11BE_ML_TWT_SUPPORT=y
CONFIG_MLD_LINK_MAX=2
CONFIG_DBDC_MODE=1
CONFIG_MTK_WIFI_6G_SUPPORT=y
CONFIG_MTK_HOST_OFFLOAD_SUPPORT=y
CONFIG_SUPPORT_FORCE_ALTX=y
```

## connectivity/wlan/core/gen4m/configs/MT6655/mobile/defconfig
```kconfig
#CONFIG_MTK_WIFI_PCIE_MSI_SUPPORT=y
#CONFIG_MTK_WIFI_FW_LOG_MMIO=y
#CONFIG_MTK_WIFI_PMIC_QUERY=y
CONFIG_TX_HIF_PORT_QUEUE_SUPPORT=y
CONFIG_MTK_WIFI_SUPPORT_UDS_FWDL=y
CONFIG_SUPPORT_TX_HIF_CREDIT_FEATURE=y
CONFIG_SUPPORT_PRE_ON_PHY_ACTION=y
CONFIG_MTK_WIFI_WFD_SCC_BALANCE=y
CONFIG_DEVICE_SUSPEND_BY_MOBILE=y
```

## connectivity/wlan/core/gen4m/configs/MT7925/ce_sqc/defconfig
```kconfig
# Note:  To disable feature, please set CONFIG_AAA=n.
#        "# CONFIG_AAA is not set" won't work.

CONFIG_SUPPORT_MLO_HYBRID=y
CONFIG_MTK_MLR_V1=y
CONFIG_MTK_MLR_V2=y
```

## connectivity/wlan/core/gen4m/configs/MT7925/defconfig
```kconfig
CONFIG_MTK_WIFI_11AX_SUPPORT=y
CONFIG_MTK_WIFI_11BE_SUPPORT=y
CONFIG_MTK_WIFI_11BE_MLO_SUPPORT=y
CONFIG_MTK_WIFI_APS_SUPPORT=y
CONFIG_MTK_WIFI_CONNAC3X=y
CONFIG_MTK_WIFI_CONNAC3X_DS_VER=3500
CONFIG_NUM_OF_WFDMA_RX_RING=2
CONFIG_NUM_OF_WFDMA_TX_RING=0
CONFIG_MTK_WIFI_UNIFIED_COMMND_SUPPORT=y
CONFIG_MTK_WIFI_TWT_SUPPORT=y
CONFIG_MTK_WIFI_TWT_STA_DIRECT_TEARDOWN=y
CONFIG_MTK_WIFI_TWT_SMART_STA=n
CONFIG_MTK_WIFI_TWT_HOTSPOT_SUPPORT=n
CONFIG_MTK_WIFI_TWT_HOTSPOT_AC_SUPPORT=n
CONFIG_MTK_WIFI_BTWT_SUPPORT=y
CONFIG_MTK_WIFI_11BE_ML_TWT_SUPPORT=y
CONFIG_MLD_LINK_MAX=2
CONFIG_MTK_WIFI_6G_SUPPORT=y
CONFIG_MTK_WIFI_DBDC_6G=y
CONFIG_SUPPORT_FORCE_ALTX=y
CONFIG_SUPPORT_TX_DATA_DELAY=n
CONFIG_SUPPORT_WIFI_DL_BT_PATCH=y
CONFIG_MTK_MDDP_SUPPORT=
CONFIG_SUPPORT_FW_IDX_LOG_TRANS=y
CONFIG_SUPPORT_FW_IDX_LOG_SAVE=y
CONFIG_SUPPORT_CE_COREDUMP=y
CONFIG_SUPPORT_DBDC_DOWNGRADE_NSS=y
CONFIG_TX_MGMT_BY_DATA_Q=y
CONFIG_SUPPORT_DEBUG_SOP=y
CONFIG_SUPPORT_OSHARE=n
CONFIG_SUPPORT_LOWLATENCY_MODE=n
CONFIG_DIRECT_READ_CHIP_INFO=y
CONFIG_SUPPORT_DUAL_WTBL_GTK_REKEY_OFFLOAD=y
CONFIG_SUPPORT_KERNEL_MAPPING_TXQ=y
CONFIG_FORCE_HW_CHECKSUM=y
CONFIG_PCIE_LTR_UPDATE=y
CONFIG_SUPPORT_BTM_OFFLOAD=y
CONFIG_MTK_WIFI_NAN=n
CONFIG_MTK_WIFI_11BE_ML_RECONFIG=y
CONFIG_MTK_WIFI_11BE_T2LM=y
CONFIG_MLO_EMLSR_CONCURRENT_ENHANCEMENT=n
CONFIG_SUPPORT_UPDTAE_HE_BSS_COLOR_FROM_BEACON=n
CONFIG_SUPPORT_SINGLE_SKU_DFS_PROTECT=n
CONFIG_SUPPORT_SINGLE_SKU_FORCE_CUSTOM_REG=n
CONFIG_SUPPORT_TESTMODE_L0P5_FWDL=y
CONFIG_MLO_CONCURRENT_SINGLE_PHY=y
```

## mtkcam/mtk-mae/Kconfig
```kconfig
config MTK_CAMERA_MAE_SUPPORT
	tristate "Mediatek Multimedia AI engine function"
	select V4L2_MEM2MEM_DEV
	depends on VIDEOBUF2_DMA_CONTIG
	help
		Support the Multimedia AI engine (MAE) feature

		MAE driver is a V4L2 device driver which
		provides hardware accelerated face detection function,
		it can detect different sizes of faces in a raw image.
```
